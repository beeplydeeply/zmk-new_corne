## config/west.yml
```yaml
manifest:
  remotes:
    - name: zmkfirmware
      url-base: https://github.com/zmkfirmware
    - name: cormoran
      url-base: https://github.com/cormoran
    # dongle_display
    - name: englmaxi
      url-base: https://github.com/englmaxi
    # nice_oled - nice_epaper - dongle_display!view - oled Adapter
    - name: mctechnology17
      url-base: https://github.com/mctechnology17
  projects:
    - name: eyelash_corne
      url: https://github.com/a741725193/zmk-new_corne
      revision: main
    - name: zmk
      remote: cormoran
      revision: v0.3-branch+dya
      import: app/west.yml
    - name: zmk-behavior-runtime-sensor-rotate
      remote: cormoran
      revision: main
    - name: zmk-module-ble-management
      remote: cormoran
      revision: zmk-v0.3.0.0
    - name: zmk-module-battery-history
      remote: cormoran
      revision: main
    - name: zmk-module-settings-rpc
      remote: cormoran
      revision: main
    - name: zmk-module-runtime-input-processor
      remote: cormoran
      revision: zmk-v0.3.0.0
    - name: zmk-corne-oled
      url: https://github.com/a741725193/zmk-corne-oled
      revision: main
      path: modules/zmk-corne-oled
    # dongle_display
    - name: zmk-dongle-display
      remote: englmaxi
      revision: v0.3
    # nice_oled - nice_epaper
    - name: zmk-nice-oled
      remote: mctechnology17
      revision: main
    # dongle_display!view
    - name: zmk-dongle-display-view
      remote: mctechnology17
      revision: main
    # oled Adapter
    - name: zmk-oled-adapter
      remote: mctechnology17
      revision: main
  self:
    path: config
```
